## solar_os/managed_components/skuodi__libssh2_esp/examples/ssh2_exec/main/Kconfig.projbuild
```kconfig
menu "libssh2 Example Configuration"

    config EXAMPLE_FS_ROOT_DIR
        string "Filesystem root directory"
        default "/storage"
        help
            The LittleFS partition will be mounted on this path such that a
            file "hello.txt"in the filesystem root directory will be accessible
            at "/storage/hello.txt" using <stdio.h> API

    config EXAMPLE_SSH_TASK_STACK_SIZE
        int "SSH task stack size"
        range 50000 100000
        default 50000
        help
            The LittleFS partition will be mounted on this path such that a
            file "hello.txt" in the <project_root>/data directory will be accessible
            at "/storage/hello.txt" using <stdio.h> API

    config EXAMPLE_SSH_HOSTNAME
        string "SSH server host name"
        default "bandit.labs.overthewire.org"
        help
            IP address or fully-qualified domain name of the SSH server.

    config EXAMPLE_SSH_PORT
        int "SSH server port"
        default 2220

    config EXAMPLE_SSH_USERNAME
        string "SSH login username"
        default "bandit0"

    config EXAMPLE_SSH_USE_PUBKEY
        bool "Use public key authentication for SSH login"
        default n

    config EXAMPLE_SSH_PASSWORD
        string "SSH login password"
        depends on EXAMPLE_SSH_USE_PUBKEY=n
        default "bandit0"
        help
            If this field is left empty, the public and private keys are used
            for authentication.

    config EXAMPLE_SSH_PRIVKEY_FILE
        string "SSH private key file"
        depends on EXAMPLE_SSH_USE_PUBKEY=y
        default "id_rsa"
        help
            Location of the SSH private key file relative to the root of the
            LittleFS root directory. Place this file in the <project_root>/data
            folder to have it uploaded to the LittleFS partition when the
            project is compiled.

    config EXAMPLE_SSH_COMMAND
        string "SSH command"
        default "ls"
        help
            Once the SSH connection is established, this command will be run
            at the CLI and the response printed to the serial console.

    config EXAMPLE_LIBSSH2_DEBUG
        bool "Enable libssh2 debug output"
        depends on LIBSSH2_DEBUG_ENABLE
        default y
        default n if LIBSSH2_DEBUG_ENABLE=n
        help
            Enable runtime debug logs of the SSH operations. Enable the individual log options below.

    config EXAMPLE_LIBSSH2_DEBUG_TRANS
        bool "Enable libssh2 transaction phase debug output"
        depends on EXAMPLE_LIBSSH2_DEBUG
        default n

    config EXAMPLE_LIBSSH2_DEBUG_KEX
        bool "Enable libssh2 key exchange phase debug output"
        depends on EXAMPLE_LIBSSH2_DEBUG
        default n
    config EXAMPLE_LIBSSH2_DEBUG_AUTH
        bool "Enable libssh2 authentication phase debug output"
        depends on EXAMPLE_LIBSSH2_DEBUG
        default n
    config EXAMPLE_LIBSSH2_DEBUG_CONN
        bool "Enable libssh2 connection phase debug output"
        depends on EXAMPLE_LIBSSH2_DEBUG
        default n
    config EXAMPLE_LIBSSH2_DEBUG_SCP
        bool "Enable libssh2 SCP phase debug output"
        depends on EXAMPLE_LIBSSH2_DEBUG
        default n
    config EXAMPLE_LIBSSH2_DEBUG_SFTP
        bool "Enable libssh2 SFTP phase debug output"
        depends on EXAMPLE_LIBSSH2_DEBUG
        default n
    config EXAMPLE_LIBSSH2_DEBUG_ERROR
        bool "Enable libssh2 error log output"
        depends on EXAMPLE_LIBSSH2_DEBUG
        default y
    config EXAMPLE_LIBSSH2_DEBUG_PUBLICKEY
        bool "Enable libssh2 public/private key debug output"
        depends on EXAMPLE_LIBSSH2_DEBUG
        default n
    config EXAMPLE_LIBSSH2_DEBUG_SOCKET
        bool "Enable libssh2 soocket debug output"
        depends on EXAMPLE_LIBSSH2_DEBUG
        default n

endmenu
```

## solar_os/managed_components/skuodi__libssh2_esp/examples/ssh2_exec/sdkconfig.defaults
```kconfig
CONFIG_ESPTOOLPY_FLASHSIZE_4MB=y
CONFIG_ESPTOOLPY_FLASHSIZE="4MB"
CONFIG_ESPTOOLPY_HEADER_FLASHSIZE_UPDATE=y
CONFIG_PARTITION_TABLE_CUSTOM=y
CONFIG_LOG_DEFAULT_LEVEL_WARN=y
CONFIG_LOG_DEFAULT_LEVEL=2
```
